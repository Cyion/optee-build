## samsung/fitImage-artik520.its
```
/dts-v1/;

/ {
	description = "U-Boot fitImage";
	#address-cells = <1>;

	images {
		kernel {
			description = "Linux kernel";
			data = /incbin/("zImage");
			type = "kernel";
			arch = "arm";
			os = "linux";
			compression = "none";
			load = <0x40008000>;
			entry = <0x40008000>;
		};

		fdt {
			description = "artik 520 flattened device tree blob";
			data = /incbin/("exynos3250-artik5.dtb");
			type = "flat_dt";
			arch = "arm";
			compression = "none";
			load = <0x40800000>;
		};

		optee {
			description = "OPTEE os";
			data = /incbin/("tee.bin");
			type = "image";
			arch = "arm";
			compression = "none";
			load = <0x57000000>;
		};
	};

	configurations {
		default = "config";

		config {
			description = "Linux kernel, FDT blob, OPTEE";
			kernel = "kernel";
			fdt = "fdt";
			loadables = "optee";
		};

	};
};
```

## samsung/fitImage-artik530.its
```
/dts-v1/;

/ {
	description = "U-Boot fitImage";
	#address-cells = <1>;

	images {
		kernel {
			description = "Linux kernel";
			data = /incbin/("zImage");
			type = "kernel";
			arch = "arm";
			os = "linux";
			compression = "none";
			load = <0x91080000>;
			entry = <0x91080000>;
		};

		fdt@1 {
			description = "artik 530 device tree blob for hwtest";
			data = /incbin/("s5p4418-artik530-explorer.dtb");
			type = "flat_dt";
			arch = "arm";
			compression = "none";
			load = <0x9B000000>;
		};

		fdt@2 {
			description = "artik 530 device tree blob original";
			data = /incbin/("s5p4418-artik530-raptor-rev00.dtb");
			type = "flat_dt";
			arch = "arm";
			compression = "none";
			load = <0x9B000000>;
		};

		fdt@3 {
			description = "artik 530 device tree blob rev 03";
			data = /incbin/("s5p4418-artik530-raptor-rev03.dtb");
			type = "flat_dt";
			arch = "arm";
			compression = "none";
			load = <0x9B000000>;
		};

		optee {
			description = "OPTEE os";
			data = /incbin/("tee.bin");
			type = "image";
			arch = "arm";
			compression = "none";
			load = <0xa8000000>;
		};
	};

	configurations {
		default = "config@1";

		config@1 {
			description = "Linux kernel, FDT blob, OPTEE";
			kernel = "kernel";
			fdt = "fdt@1";
			loadables = "optee";
		};

		config@2 {
			description = "Linux kernel, FDT blob, OPTEE";
			kernel = "kernel";
			fdt = "fdt@2";
			loadables = "optee";
		};

		config@3 {
			description = "Linux kernel, FDT blob, OPTEE";
			kernel = "kernel";
			fdt = "fdt@3";
			loadables = "optee";
		};
	};
};
```
